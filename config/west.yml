## config/west.yml
```yaml
manifest:
  remotes:
    - name: zmkfirmware
      url-base: https://github.com/zmkfirmware
    - name: urob
      url-base: https://github.com/urob

  projects:
    - name: zmk-helpers
      revision: v0.3 # should match the ZMK release
      path: modules/helpers
      remote: urob
    # - name: zmk-auto-layer
    #   revision: main
    #   path: modules/auto-layer
    # - name: zmk-tri-state
    #   revision: main
    #   path: modules/tri-state

    # My config
    - name: zmk
      remote: zmkfirmware
      revision: v0.3 # pinned release; main moved to Zephyr 4.1 and renamed boards
      import: app/west.yml
  self:
    path: config
```
